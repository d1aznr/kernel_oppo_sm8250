## arch/arm64/boot/dts/vendor/Kconfig
```kconfig
config VENDOR_DTS_PROJECTS
	string "Vendor DTS project folder(s)"
	default "qcom"
	help
	  Space-separated list of project folder names under vendor/ to build DTS for.

	  Example values:
	    "qcom"             - single project
	    "20351 qcom oplus" - multiple projects
```

## drivers/power/Kconfig
```kconfig
config CHARGER_OPPO
	bool "Build oppo charger driver"
	depends on SENSORS_SIMULATED_HALL
	default n
	help
	  Build oppo charger driver

source "drivers/power/avs/Kconfig"
source "drivers/power/reset/Kconfig"
source "drivers/power/supply/Kconfig"

source "drivers/power/oplus/Kconfig"
source "drivers/power/oppo/Kconfig"
```

## techpack/Kconfig
```kconfig
menu "Tech packages"

config TECHPACK_CAMERA_OPPO
	bool "Build oppo camera driver"
	default n
	help
	  Build oppo camera driver

source "techpack/data/Kconfig"

endmenu
```
